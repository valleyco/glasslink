## main/Kconfig.projbuild
```kconfig
menu "wl-display"

config WD_WIFI_SSID
    string "WiFi SSID"
    default "CHANGE_ME"

config WD_WIFI_PASS
    string "WiFi password"
    default "CHANGE_ME"

config WD_MQTT_URI
    string "MQTT broker URI"
    default "mqtt://192.168.1.1:1883"

config WD_DEVICE_ID
    string "Device id (wd/{id}/...)"
    default "cyd1"

endmenu
```

## sdkconfig.defaults
```kconfig
# Shared defaults (all targets).
CONFIG_ESP_CONSOLE_UART_DEFAULT=y
CONFIG_ESP_CONSOLE_UART_BAUDRATE=115200
CONFIG_FREERTOS_HZ=1000
CONFIG_PARTITION_TABLE_SINGLE_APP=y
```
